## config/west.yml
```yaml
manifest:
  defaults:
    revision: v0.3
  remotes:
    - name: zmkfirmware
      url-base: https://github.com/zmkfirmware
    - name: my-modules
      url-base: https://github.com/CassiopeMN
      
  projects:
    - name: zmk
      remote: zmkfirmware
      import: app/west.yml
    # ПОДКЛЮЧАЕМ НАШ НОВЫЙ МОДУЛЬ
    - name: zmk-splitsense-matrix
      remote: my-modules
      revision: main
  self:
    path: config
```
